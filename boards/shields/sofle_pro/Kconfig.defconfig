## boards/shields/sofle_pro/Kconfig.defconfig
```kconfig
if SHIELD_SOFLE_PRO_DONGLE
# Name must be less than 16 characters long!
config ZMK_KEYBOARD_NAME
    default "Sofle Pro"

config ZMK_SPLIT_ROLE_CENTRAL
    default y

config ZMK_SPLIT
    default y

config ZMK_SPLIT_BLE_CENTRAL_PERIPHERALS
    default 2

config BT_MAX_CONN
    default 7

config BT_MAX_PAIRED
    default 7

endif

if SHIELD_SOFLE_PRO_LEFT || SHIELD_SOFLE_PRO_RIGHT
config ZMK_SPLIT
    default y

config ZMK_SPLIT_ROLE_CENTRAL
    default n
endif
```

## boards/shields/sofle_pro_display/Kconfig.defconfig
```kconfig
if SHIELD_SOFLE_PRO_DISPLAY

choice ZMK_DISPLAY_STATUS_SCREEN
    default ZMK_DISPLAY_STATUS_SCREEN_CUSTOM
endchoice

choice ZMK_DISPLAY_WORK_QUEUE
    default ZMK_DISPLAY_WORK_QUEUE_DEDICATED
endchoice

choice LV_COLOR_DEPTH
    default LV_COLOR_DEPTH_1
endchoice

config ZMK_DISPLAY_STATUS_SCREEN_CUSTOM
    select LV_USE_LABEL
    select LV_USE_IMAGE
    select LV_USE_FLEX
    imply LV_USE_THEME_MONO if LV_Z_BITS_PER_PIXEL=1
    imply CUSTOM_WIDGET_BATTERY_STATUS
    imply CUSTOM_WIDGET_LAYER_STATUS
    imply CUSTOM_WIDGET_OUTPUT_STATUS
    imply CUSTOM_WIDGET_PERIPHERAL_STATUS
    imply CUSTOM_WIDGET_INDICATORS_STATUS

config CUSTOM_WIDGET_BATTERY_STATUS
    bool "Sofle Pro custom battery status widget"
    select LV_USE_LABEL

config CUSTOM_WIDGET_LAYER_STATUS
    bool "Sofle Pro custom layer status widget"
    depends on !ZMK_SPLIT || ZMK_SPLIT_ROLE_CENTRAL
    select LV_USE_LABEL

config CUSTOM_WIDGET_OUTPUT_STATUS
    bool "Sofle Pro custom output status widget"
    depends on BT && (!ZMK_SPLIT_BLE || ZMK_SPLIT_ROLE_CENTRAL)
    select LV_USE_LABEL

config CUSTOM_WIDGET_PERIPHERAL_STATUS
    bool "Sofle Pro custom peripheral status widget"
    depends on BT && ZMK_SPLIT_BLE
    select LV_USE_LABEL

config CUSTOM_WIDGET_WPM_STATUS
    bool "Sofle Pro custom WPM status widget"
    depends on !ZMK_SPLIT || ZMK_SPLIT_ROLE_CENTRAL
    select LV_USE_LABEL
    select ZMK_WPM

config CUSTOM_WIDGET_INDICATORS_STATUS
    bool "Sofle Pro custom HID indicators status widget"
    depends on !ZMK_SPLIT || ZMK_SPLIT_ROLE_CENTRAL
    select LV_USE_LABEL
    select ZMK_HID_INDICATORS

config LV_Z_MEM_POOL_SIZE
    default 81920

config LV_Z_VDB_SIZE
    default 10

config LV_DPI_DEF
    default 130

config LV_Z_BITS_PER_PIXEL
    default 1

endif
```

## boards/shields/sofle_pro_display/Kconfig.shield
```kconfig
config SHIELD_SOFLE_PRO_DISPLAY
    def_bool $(shields_list_contains,sofle_pro_display)
```
